## RV1106_BUILDROOT/package/luckfox-localizer/Config.in
```kconfig
config BR2_PACKAGE_LUCKFOX_LOCALIZER
	bool "luckfox-localizer"
	depends on BR2_INSTALL_LIBSTDCPP
	select BR2_PACKAGE_YDLIDAR_SDK
	help
	  Lightweight occupancy-grid scan localizer for Luckfox Pico RV1106.
	  Installs map_inspect, localize_scan and localize_uart in /usr/bin.

comment "luckfox-localizer needs C++ support"
	depends on !BR2_INSTALL_LIBSTDCPP
```

## RV1106_BUILDROOT/package/ydlidar-sdk/Config.in
```kconfig
config BR2_PACKAGE_YDLIDAR_SDK
	bool "ydlidar-sdk"
	depends on BR2_INSTALL_LIBSTDCPP
	help
	  YDLidar serial/network device SDK used by the realtime localizer.
```
